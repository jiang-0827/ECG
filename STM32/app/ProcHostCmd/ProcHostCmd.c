/*********************************************************************************************************
* 模 块 名 称：ProcHostCmd.c
* 摘        要：ProcHostCmd模块，上位机命令解析与分发
* 当前版本：1.0.0
* 作        者：SZLY(COPYRIGHT 2018 - 2026 SZLY. All rights reserved.)
* 生成日期：2026年09月20日
* 说        明：本文件由STM32F103版本移植而来
* 注        意：命令处理函数一律"改状态/回ACK"，绝不做耗时操作，保证2ms任务不被拖死
**********************************************************************************************************
* 取消版本：
* 作        者：
* 生成日期：
* 修改内容：
* 修改文件：
*********************************************************************************************************/
/*********************************************************************************************************
*                                              包含头文件
*********************************************************************************************************/
#include <stdio.h>
#include "ProcHostCmd.h"
#include "Main.h"
#include "PackUnpack.h"
#include "SendDataToHost.h"
#include "ADC.h"

/*********************************************************************************************************
*                                              宏定义
*********************************************************************************************************/

/*********************************************************************************************************
*                                              枚举结构体定义
*********************************************************************************************************/

/*********************************************************************************************************
*                                              内部变量
*********************************************************************************************************/

/*********************************************************************************************************
*                                              内部函数声明
*********************************************************************************************************/
static u8  OnWaveSwitch(u8* pMsg);   //波形数据帧上传开关应答处理
static u8  OnSetRate(u8* pMsg);      //设置采样率应答处理
static u8  OnGetRate(u8* pMsg);      //查询采样率应答处理
static u8  OnSetChannel(u8* pMsg);   //设置ADC通道应答处理
static u8  OnGetStatus(u8* pMsg);    //查询运行状态应答处理
static u8  OnClrCount(u8* pMsg);     //清零统计量应答处理

/*********************************************************************************************************
*                                              内部函数实现
*********************************************************************************************************/
/*********************************************************************************************************
* 函数名称：OnWaveSwitch
* 功能功能：波形数据帧上传开关应答处理
* 输入参数：pMsg，命令数据首地址，pMsg[0]为开关(0-停止，1-上传)
* 输出参数：void
* 返 回 值：应答消息
* 生成日期：2026年09月20日
* 注    意：对应MODULE_WAVE + CMD_GEN_WAVE(0x80)，F103里该命令是设置DAC波形
**********************************************************************************************************/
static u8 OnWaveSwitch(u8* pMsg)
{
  if(pMsg[0] > 1)
  {
    return(CMD_ACK_PARAM_ERR);  //参数非法
  }

  SetWaveSendEnable(pMsg[0]);   //设置上传开关

  return(CMD_ACK_OK);           //命令处理成功
}

/*********************************************************************************************************
* 函数名称：OnSetRate
* 功能功能：设置采样率应答处理
* 输入参数：pMsg，pMsg[0]=采样率低字节，pMsg[1]=采样率高字节(HZ，小端)
* 输出参数：void
* 返 回 值：应答消息
* 生成日期：2026年09月20日
* 注    意：
**********************************************************************************************************/
static u8 OnSetRate(u8* pMsg)
{
  u16 rate;

  rate = (u16)pMsg[0] | ((u16)pMsg[1] << 8);  //小端拼成16位

  if((rate == 0) || (rate > 20000))
  {
    return(CMD_ACK_PARAM_ERR);
  }

  SetADCSampleRate(rate);  //设置ADC采样率

  return(CMD_ACK_OK);
}

/*********************************************************************************************************
* 函数名称：OnGetRate
* 功能功能：查询采样率应答处理
* 输入参数：pMsg
* 输出参数：void
* 返 回 值：应答消息
* 生成日期：2026年09月20日
* 注    意：结果同时从printf通道打印一份，方便没有上位机时用串口助手验证
**********************************************************************************************************/
static u8 OnGetRate(u8* pMsg)
{
  printf("ECG sample rate = %d Hz\r\n", GetADCSampleRate());

  return(CMD_ACK_OK);
}

/*********************************************************************************************************
* 函数名称：OnSetChannel
* 功能功能：设置ADC规则通道应答处理
* 输入参数：pMsg，pMsg[0]=ADC_Channel_x(0~18)
* 输出参数：void
* 返 回 值：应答消息
* 生成日期：2026年09月20日
* 注    意：切通道不会改GPIO，若切到别的引脚需自行把该引脚配成模拟输入
**********************************************************************************************************/
static u8 OnSetChannel(u8* pMsg)
{
  if(pMsg[0] > 18)
  {
    return(CMD_ACK_PARAM_ERR);
  }

  SetADCChannel(pMsg[0]);  //切换ADC规则通道

  return(CMD_ACK_OK);
}

/*********************************************************************************************************
* 函数名称：OnGetStatus
* 功能功能：查询骨架运行状态应答处理
* 输入参数：pMsg
* 输出参数：void
* 返 回 值：应答消息
* 生成日期：2026年09月20日
* 注    意：
**********************************************************************************************************/
static u8 OnGetStatus(u8* pMsg)
{
  printf("ECG status: rate=%dHz cnt=%lu drop=%lu queue=%d peak=%d wave=%d\r\n",
          GetADCSampleRate(),
          (unsigned long)GetADCSampleCnt(),
          (unsigned long)GetADCDropCnt(),
          GetADCQueueLen(),
          GetADCQueuePeak(),
          GetWaveSendEnable());

  return(CMD_ACK_OK);
}

/*********************************************************************************************************
* 函数名称：OnClrCount
* 功能功能：清零统计量应答处理
* 输入参数：pMsg
* 输出参数：void
* 返 回 值：应答消息
* 生成日期：2026年09月20日
* 注    意：
**********************************************************************************************************/
static u8 OnClrCount(u8* pMsg)
{
  ClearADCStatic();  //清零采样计数/丢弃计数/队列峰值

  return(CMD_ACK_OK);
}

/*********************************************************************************************************
*                                              API函数实现
*********************************************************************************************************/
/*********************************************************************************************************
* 函数名称：InitProcHostCmd
* 功能功能：初始化ProcHostCmd模块
* 输入参数：void
* 输出参数：void
* 返 回 值：void
* 生成日期：2018年01月01日
* 注    意：
**********************************************************************************************************/
void  InitProcHostCmd(void)
{

}

/*********************************************************************************************************
* 函数名称：ProcHostCmd
* 功能功能：处理来自上位机的数据
* 输入参数：recData
* 输出参数：void
* 返 回 值：void
* 生成日期：2018年01月01日
* 注    意：
**********************************************************************************************************/
void ProcHostCmd(u8 recData)
{
  StructPackType pack;    //定义结构体变量
  u8 ack;                 //存储应答消息

  while(UnPackData(recData))   //解析成功
  {
    pack = GetUnPackRslt();    //获取解析结果

    switch(pack.packModuleId)  //模块ID
    {
      case MODULE_WAVE:         //wave模块信息
        switch(pack.packSecondId)
        {
          case CMD_GEN_WAVE:    //波形上传开关
            ack = OnWaveSwitch(pack.arrData);
            break;
          default:
            ack = CMD_ACK_BAD_CMD;
            break;
        }
        SendAckPack(MODULE_WAVE, pack.packSecondId, ack);  //发送命令应答消息
        break;

      case MODULE_ECG:          //心电模块信息
        switch(pack.packSecondId)
        {
          case CMD_ECG_SET_RATE:  //设置采样率
            ack = OnSetRate(pack.arrData);
            break;
          case CMD_ECG_GET_RATE:  //查询采样率
            ack = OnGetRate(pack.arrData);
            break;
          case CMD_ECG_SET_CH:    //设置ADC通道
            ack = OnSetChannel(pack.arrData);
            break;
          case DAT_ECG_STS:       //查询运行状态
            ack = OnGetStatus(pack.arrData);
            break;
          case CMD_ECG_CLR_CNT:   //清零统计量
            ack = OnClrCount(pack.arrData);
            break;
          default:                //其余心电命令(滤波/增益/导联等)等算法接入后再实现
            ack = CMD_ACK_BAD_CMD;
            break;
        }
        SendAckPack(MODULE_ECG, pack.packSecondId, ack);  //发送命令应答消息
        break;

      default:
        break;
    }
  }
}
