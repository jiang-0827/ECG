/*********************************************************************************************************
* 模 块 名 称：SysTick.c
* 摘        要：SysTick模块，SysTick初始化以及毫秒/微秒级延时函数
* 当前版本：1.0.0
* 作        者：SZLY(COPYRIGHT 2018 - 2026 SZLY. All rights reserved.)
* 生成日期：2026年09月20日
* 说        明：本文件由STM32F103版本移植而来
* 注        意：
**********************************************************************************************************
* 取消版本：
* 作        者：
* 生成日期：
* 修改内容：
* 修改文件：
*********************************************************************************************************/
/*********************************************************************************************************
*                                              包含头文件
*********************************************************************************************************/
#include "SysTick.h"
#include "stm32f4xx_conf.h"

/*********************************************************************************************************
*                                              宏定义
*********************************************************************************************************/

/*********************************************************************************************************
*                                              枚举结构体定义
*********************************************************************************************************/

/*********************************************************************************************************
*                                              内部变量
*********************************************************************************************************/
static  __IO  u32 s_iTimDelayCnt = 0;   //延时计数器s_iTimDelayCnt的初值为0

/*********************************************************************************************************
*                                              内部函数声明
*********************************************************************************************************/
static  void  TimDelayDec(void); //延时递减

/*********************************************************************************************************
*                                              内部函数实现
*********************************************************************************************************/
/*********************************************************************************************************
* 函数名称：TimDelayDec
* 功能功能：延时递减
* 输入参数：void
* 输出参数：void
* 返 回 值：void
* 生成日期：2018年01月01日
* 注    意：在SysTick中断服务函数SysTick_Handler中调用
**********************************************************************************************************/
static  void TimDelayDec(void)
{
  if(s_iTimDelayCnt != 0) //延时计数器计数值不为0
  {
    s_iTimDelayCnt--;     //延时计数器计数值减1
  }
}

/*********************************************************************************************************
* 函数名称：SysTick_Handler
* 功能功能：SysTick中断服务函数
* 输入参数：void
* 输出参数：void
* 返 回 值：void
* 生成日期：2018年01月01日
* 注    意：函数名必须与startup_stm32f40xx.s中的向量表条目一致，
*           module/stm32f4xx_it.c中的同名函数已删除，避免重复定义
**********************************************************************************************************/
void  SysTick_Handler(void)
{
  TimDelayDec();  //延时递减
}

/*********************************************************************************************************
*                                              API函数实现
*********************************************************************************************************/
/*********************************************************************************************************
* 函数名称：InitSysTick
* 功能功能：初始化SysTick模块
* 输入参数：void
* 输出参数：void
* 返 回 值：void
* 生成日期：2018年01月01日
* 注    意：SystemCoreClock/1000  1ms中断一次(计数1000次为1s，每计一次为1ms)
*           SystemCoreClock/1000000 1us中断一次(计数1000000次为1s，每计一次为1us)
*           SysTick_Config()内部使用HCLK作为计数时钟，F407下SystemCoreClock=168MHz
**********************************************************************************************************/
void InitSysTick(void)
{
  if (SysTick_Config(SystemCoreClock / 1000)) //设置系统滴答定时器1ms中断一次
  {
    while(1)  //配置错误情况下，进入死循环
    {

    }
  }
}

/*********************************************************************************************************
* 函数名称：DelayNms
* 功能功能：毫秒级延时函数
* 输入参数：nms
* 输出参数：void
* 返 回 值：void
* 生成日期：2018年01月01日
* 注    意：依赖SysTick中断，需先调用InitSysTick()
**********************************************************************************************************/
void  DelayNms(__IO u32 nms)
{
  s_iTimDelayCnt = nms;       //将延时计数器s_iTimDelayCnt初值设置为nms

  while(s_iTimDelayCnt != 0)  //延时计数器初值为0时，表示延时nms结束，退出while语句
  {

  }
}

/*********************************************************************************************************
* 函数名称：DelayNus
* 功能功能：微秒级延时函数
* 输入参数：nus
* 输出参数：void
* 返 回 值：void
* 生成日期：2018年01月01日
* 注    意：软件循环近似延时(按72MHz标定的空循环次数，168MHz下实际时间偏短约一半)，
*           仅用于对精度要求不高的场合；需要精确us延时时请改用定时器
**********************************************************************************************************/
void  DelayNus(__IO u32 nus)
{
  u32 s_iTimCnt = nus;     //定义一个变量s_iTimCnt作为延时计数器，初值为nus
  u16 i;                   //定义一个变量作为循环计数器

  while(s_iTimCnt != 0)    //延时计数器s_iTimCnt初值不为0
  {
    for(i = 0; i < 7; i++) //用循环次数来延时时间
    {

    }

    s_iTimCnt--;           //每成功延时1us，计数s_iTimCnt减1
  }
}
